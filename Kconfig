## Kconfig
```kconfig
mainmenu "EFI Runtime Test $(EFIRTVERSION) Configuration"

comment "Compiler: $(CC_VERSION_TEXT)"

source "arch/Kconfig"
source "drivers/Kconfig"

menu "General setup"

config dummy
	bool "dummy"

endmenu
```

## arch/Kconfig
```kconfig
choice
	prompt "Architecture select"
	default AARCH64

config AARCH64
	bool "ARM 64bit"

config ARM
	bool "ARM 32bit"

endchoice
```

## drivers/serial/Kconfig
```kconfig
menu "Serial drivers"

choice
	prompt "Select UART driver"	

config SERIAL_PL010
	bool "ARM PL010 driver"
	help
	 Driver for PL010 UART

endchoice

config BAUDRATE
	int "Baudrate"
	default 115200
	help
	 "Value for the baudrate"

config UART_BASE
	hex "UART base address"

config UART_CLOCK
	int "UART clock rate"

config UART_SHIFT
	int "UART register shift"
	help
	 "Distance in bytes between registers of the device"

endmenu
```
